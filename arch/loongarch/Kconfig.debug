## arch/loongarch/Kconfig.debug
```kconfig
choice
	prompt "Choose kernel unwinder"
	default UNWINDER_PROLOGUE if KALLSYMS
	help
	  This determines which method will be used for unwinding kernel stack
	  traces for panics, oopses, bugs, warnings, perf, /proc/<pid>/stack,
	  livepatch, lockdep, and more.

config UNWINDER_GUESS
	bool "Guess unwinder"
	help
	  This option enables the "guess" unwinder for unwinding kernel stack
	  traces.  It scans the stack and reports every kernel text address it
	  finds.  Some of the addresses it reports may be incorrect.

config UNWINDER_PROLOGUE
	bool "Prologue unwinder"
	depends on KALLSYMS
	help
	  This option enables the "prologue" unwinder for unwinding kernel stack
	  traces.  It unwind the stack frame based on prologue code analyze.  Symbol
	  information is needed, at least the address and length of each function.
	  Some of the addresses it reports may be incorrect.

config UNWINDER_ORC
	bool "ORC unwinder"
	select OBJTOOL
	help
	  This option enables the ORC (Oops Rewind Capability) unwinder for
	  unwinding kernel stack traces.  It uses a custom data format which is
	  a simplified version of the DWARF Call Frame Information standard.

	  This unwinder is more accurate across interrupt entry frames than the
	  frame pointer unwinder.  It also enables a 5-10% performance
	  improvement across the entire kernel compared to frame pointers.

	  Enabling this option will increase the kernel's runtime memory usage
	  by roughly 3-5MB, depending on your kernel config.

endchoice

config DEBUG_ZBOOT
	bool "Enable compressed kernel support debugging"
	depends on DEBUG_KERNEL && SYS_SUPPORTS_ZBOOT
	default n
	help
	  If you want to add compressed kernel support to a new board, and the
	  board supports uart16550 compatible serial port, please select
	  SYS_SUPPORTS_ZBOOT_UART16550 for your board and enable this option to
	  debug it.

	  If your board doesn't support uart16550 compatible serial port, you
	  can try to select SYS_SUPPORTS_ZBOOT and use the other methods to
	  debug it. for example, add a new serial port support just as
	  arch/loongarch/boot/compressed/uart-16550.c does.

	  After the compressed kernel support works, please disable this option
	  to reduce the kernel image size and speed up the booting procedure a
	  little.
```

## drivers/platform/loongarch/Kconfig
```kconfig
#
# LoongArch Platform Specific Drivers
#

menuconfig LOONGARCH_PLATFORM_DEVICES
	bool "LoongArch Platform Specific Device Drivers"
	default y
	help
	  Say Y here to get to see options for device drivers of various
	  LOONGARCH platforms, including vendor-specific netbook/laptop/desktop
	  extension and hardware monitor drivers. This option itself does
	  not add any kernel code.

	  If you say N, all options in this submenu will be skipped and disabled.

if LOONGARCH_PLATFORM_DEVICES

config CPU_HWMON
	bool "Loongson CPU HWMon Driver"
	depends on MACH_LOONGSON64
	select HWMON
	default y
	help
	  Loongson-3A/3B/3C CPU Hwmon (temperature sensor) driver.

config GENERIC_LAPTOP
	tristate "Generic Loongson-3A Laptop Driver"
	depends on MACH_LOONGSON64
	select BACKLIGHT_LCD_SUPPORT
	select LCD_CLASS_DEVICE
	select BACKLIGHT_CLASS_DEVICE
	select POWER_SUPPLY
	select HWMON
	select VIDEO_OUTPUT_CONTROL
	select INPUT_SPARSEKMAP
	select INPUT_EVDEV
	select LEDS_CLASS
	depends on INPUT
	depends on ACPI
	default y
	help
	  Loongson-3A/3B/3C family laptops generic driver.

endif # LOONGARCH_PLATFORM_DEVICES
```
